## config/west.yml
```yaml
manifest:
  remotes:
    - name: zmkfirmware
      url-base: https://github.com/zmkfirmware
    - name: refil
      url-base: https://github.com/refil
    - name: urob
      url-base: https://github.com/urob
  projects:
    - name: zmk
      remote: refil
      revision: adv360-z3.5-2
      import: app/west.yml
    - name: zmk-unicode
      remote: urob
      revision: 52142a4258393975aad183da5f118dc1cf55e1e9
  self:
    path: config
```
